## oe-recipes/conf/layer.conf
```bitbake
BBPATH .= ":${LAYERDIR}"

BBFILES += "${LAYERDIR}/recipes-*/*/*.bb \
            ${LAYERDIR}/recipes-*/*/*.bbappend"

BBFILE_COLLECTIONS += "onekvm-video-soph-mmf"
BBFILE_PATTERN_onekvm-video-soph-mmf := "^${LAYERDIR}/"
BBFILE_PRIORITY_onekvm-video-soph-mmf = "8"

LAYERDEPENDS_onekvm-video-soph-mmf = "core onekvm-bsp osdrv-sg200x"
LAYERSERIES_COMPAT_onekvm-video-soph-mmf = "wrynose"
```
